# file: stm32h7-tetris.ioc
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FREERTOS.Tasks01=lcdTask,24,128,StartLcdTask,Default,NULL,Dynamic,NULL,NULL;inputTask,8,128,StartInputTask,Default,NULL,Dynamic,NULL,NULL
Mcu.Family=STM32H7
Mcu.Name=STM32H750XBHx
Mcu.Package=TFBGA240
NVIC.PriorityGroup=NVIC_PRIORITYGROUP_4
ProjectManager.HeapSize=0x200
ProjectManager.StackSize=0x400
ProjectManager.TargetToolchain=STM32CubeIDE
RCC.ADCFreq_Value=129000000
RCC.APB1Freq_Value=64000000
RCC.APB2Freq_Value=64000000
RCC.APB3Freq_Value=64000000
RCC.APB4Freq_Value=64000000
RCC.CortexFreq_Value=64000000
RCC.HCLKFreq_Value=64000000
RCC.SYSCLKFreq_VALUE=64000000
RCC.USBFreq_Value=129000000
VP_FREERTOS_VS_CMSIS_V2.Mode=CMSIS_V2
board=custom

// file: Core/Src/main.c
/* USER CODE BEGIN Header */
/**
 ******************************************************************************
 * @file           : main.c
 * @brief          : Main program body
 ******************************************************************************
 * @attention
 *
 * Copyright (c) 2023 STMicroelectronics.
 * All rights reserved.
 *
 * This software is licensed under terms that can be found in the LICENSE file
 * in the root directory of this software component.
 * If no LICENSE file comes with this software, it is provided AS-IS.
 *
 ******************************************************************************
 */
 /* USER CODE END Header */
 /* Includes ------------------------------------------------------------------*/
#include "main.h"
#include "cmsis_os.h"

/* Definitions for lcdTask */
osThreadId_t lcdTaskHandle;
const osThreadAttr_t lcdTask_attributes = { .name = "lcdTask", .stack_size = 128
        * 4, .priority = (osPriority_t)osPriorityNormal, };
/* Definitions for inputTask */
osThreadId_t inputTaskHandle;
const osThreadAttr_t inputTask_attributes = { .name = "inputTask", .stack_size =
        128 * 4, .priority = (osPriority_t)osPriorityLow, };
/* USER CODE BEGIN PV */
osMessageQueueId_t actionQueue;
TIM_HandleTypeDef tim2;
RNG_HandleTypeDef rng;
/* USER CODE END PV */

void SystemClock_Config(void);
void StartLcdTask(void* argument);
void StartInputTask(void* argument);

/* USER CODE BEGIN PFP */
static void LCD_Config(void);
static void TS_Config(void);
static void TIM_Config(void);
static void BTN_Config(void);
static void RNG_Config(void);
static void MMC_Config(void);
/* USER CODE END PFP */

int main(void) {

    /* MCU Configuration--------------------------------------------------------*/

    /* Reset of all peripherals, Initializes the Flash interface and the Systick. */
    HAL_Init();

    /* Configure the system clock */
    SystemClock_Config();

    /* USER CODE BEGIN SysInit */
    TS_Config();
    RNG_Config();
    LCD_Config();
    TIM_Config();
    BTN_Config();
    MMC_Config();
    /* USER CODE END SysInit */

    /* Initialize all configured peripherals */

    /* Init scheduler */
    osKernelInitialize();

    /* USER CODE BEGIN RTOS_QUEUES */
    actionQueue = osMessageQueueNew(32, sizeof(action_t), NULL);
    /* USER CODE END RTOS_QUEUES */

    /* Create the thread(s) */
    /* creation of lcdTask */
    lcdTaskHandle = osThreadNew(StartLcdTask, NULL, &lcdTask_attributes);

    /* creation of inputTask */
    inputTaskHandle = osThreadNew(StartInputTask, NULL, &inputTask_attributes);

    /* USER CODE BEGIN RTOS_EVENTS */
    /* add events, ... */
    HAL_TIM_Base_Start_IT(&tim2);
    reset_game();
    load_game();
    /* USER CODE END RTOS_EVENTS */

    /* Start scheduler */
    osKernelStart();

    /* We should never get here as control is now taken by the scheduler */
    /* Infinite loop */
    while (1) {

    }
}

void SystemClock_Config(void) {
    RCC_ClkInitTypeDef RCC_ClkInitStruct = { 0 };
    RCC_OscInitTypeDef RCC_OscInitStruct = { 0 };

    /*!< Supply configuration update enable */
    HAL_PWREx_ConfigSupply(PWR_LDO_SUPPLY);

    /* The voltage scaling allows optimizing the power consumption when the device is
     clocked below the maximum system frequency, to update the voltage scaling value
     regarding system frequency refer to product datasheet.  */
    __HAL_PWR_VOLTAGESCALING_CONFIG(PWR_REGULATOR_VOLTAGE_SCALE1);

    while (!__HAL_PWR_GET_FLAG(PWR_FLAG_VOSRDY)) {
    }

    RCC_OscInitStruct.OscillatorType = RCC_OSCILLATORTYPE_HSI48 | RCC_OSCILLATORTYPE_HSE;
    RCC_OscInitStruct.HSEState = RCC_HSE_BYPASS;
    RCC_OscInitStruct.HSI48State = RCC_HSI48_ON;
    RCC_OscInitStruct.PLL.PLLState = RCC_PLL_ON;
    RCC_OscInitStruct.PLL.PLLSource = RCC_PLLSOURCE_HSE;
    RCC_OscInitStruct.PLL.PLLM = 5;
    RCC_OscInitStruct.PLL.PLLN = 160;
    RCC_OscInitStruct.PLL.PLLP = 2;
    RCC_OscInitStruct.PLL.PLLQ = 2;
    RCC_OscInitStruct.PLL.PLLR = 2;
    RCC_OscInitStruct.PLL.PLLRGE = RCC_PLL1VCIRANGE_2;
    RCC_OscInitStruct.PLL.PLLVCOSEL = RCC_PLL1VCOWIDE;
    RCC_OscInitStruct.PLL.PLLFRACN = 0;
    if (HAL_RCC_OscConfig(&RCC_OscInitStruct) != HAL_OK) {
        Error_Handler();
    }

    /** Initializes the CPU, AHB and APB buses clocks
    */
    RCC_ClkInitStruct.ClockType = RCC_CLOCKTYPE_HCLK | RCC_CLOCKTYPE_SYSCLK
        | RCC_CLOCKTYPE_PCLK1 | RCC_CLOCKTYPE_PCLK2
        | RCC_CLOCKTYPE_D3PCLK1 | RCC_CLOCKTYPE_D1PCLK1;
    RCC_ClkInitStruct.SYSCLKSource = RCC_SYSCLKSOURCE_PLLCLK;
    RCC_ClkInitStruct.SYSCLKDivider = RCC_SYSCLK_DIV1;
    RCC_ClkInitStruct.AHBCLKDivider = RCC_HCLK_DIV2;
    RCC_ClkInitStruct.APB3CLKDivider = RCC_APB3_DIV2;
    RCC_ClkInitStruct.APB1CLKDivider = RCC_APB1_DIV2;
    RCC_ClkInitStruct.APB2CLKDivider = RCC_APB2_DIV2;
    RCC_ClkInitStruct.APB4CLKDivider = RCC_APB4_DIV2;

    if (HAL_RCC_ClockConfig(&RCC_ClkInitStruct, FLASH_LATENCY_2) != HAL_OK) {
        Error_Handler();
    }

    /*
     Note : The activation of the I/O Compensation Cell is recommended with communication  interfaces
     (GPIO, SPI, FMC, QSPI ...)  when  operating at  high frequencies(please refer to product datasheet)
     The I/O Compensation Cell activation  procedure requires :
     - The activation of the CSI clock
     - The activation of the SYSCFG clock
     - Enabling the I/O Compensation Cell : setting bit[0] of register SYSCFG_CCCSR
     */

     /*activate CSI clock mandatory for I/O Compensation Cell*/
    __HAL_RCC_CSI_ENABLE();

    /* Enable SYSCFG clock mandatory for I/O Compensation Cell */
    __HAL_RCC_SYSCFG_CLK_ENABLE()
        ;

    /* Enables the I/O Compensation Cell */
    HAL_EnableCompensationCell();
}

/* USER CODE BEGIN 4 */
static void LCD_Config(void) {
    BSP_LCD_Init(0, LCD_ORIENTATION_LANDSCAPE);
    BSP_LCD_SetLayerAddress(0, 0, LCD_LAYER_0_ADDRESS);
    UTIL_LCD_SetFuncDriver(&LCD_Driver);
    UTIL_LCD_SetFont(&Font12);
    UTIL_LCD_SetBackColor(UTIL_LCD_COLOR_BLACK);
    UTIL_LCD_SetTextColor(UTIL_LCD_COLOR_WHITE);
    UTIL_LCD_Clear(UTIL_LCD_COLOR_BLACK);
    HAL_NVIC_SetPriority(LTDC_IRQn, 10, 10);
    HAL_NVIC_EnableIRQ(LTDC_IRQn);
}

static void TS_Config(void) {
    TS_Init_t init = { TS_MAX_WIDTH, TS_MAX_HEIGHT, TS_SWAP_XY, 5 };
    BSP_TS_Init(0, &init);
}

static void TIM_Config(void) {
    //Timer base frequency is 200MHz
    //An interrupt is triggered every 10ms
    __HAL_RCC_TIM2_CLK_ENABLE();
    HAL_NVIC_SetPriority(TIM2_IRQn, 10, 10);
    HAL_NVIC_EnableIRQ(TIM2_IRQn);
    tim2.Instance = TIM2;
    tim2.Init.CounterMode = TIM_COUNTERMODE_UP;
    tim2.Init.Period = 10000 - 1;
    tim2.Init.Prescaler = 200 - 1;
    HAL_TIM_Base_Init(&tim2);
    __HAL_TIM_CLEAR_FLAG(&tim2, TIM_FLAG_UPDATE);
}

static void BTN_Config(void) {
    __HAL_RCC_GPIOC_CLK_ENABLE();
    HAL_NVIC_SetPriority(EXTI15_10_IRQn, 10, 10);
    HAL_NVIC_EnableIRQ(EXTI15_10_IRQn);

    GPIO_InitTypeDef init = { 0 };
    init.Pin = GPIO_PIN_13;
    init.Mode = GPIO_MODE_IT_RISING;
    init.Speed = GPIO_SPEED_FREQ_LOW;
    init.Pull = GPIO_PULLDOWN;

    HAL_GPIO_Init(GPIOC, &init);
}

static void RNG_Config(void) {
    __HAL_RCC_RNG_CLK_ENABLE();
    rng.Instance = RNG;
    rng.Init.ClockErrorDetection = RNG_CED_ENABLE;
    if (HAL_RNG_Init(&rng) != HAL_OK) {
        Error_Handler();
    }
}

static void MMC_Config(void) {
    int32_t mmc_state = BSP_MMC_Init(0);
}

void HAL_LTDC_ReloadEventCallback(LTDC_HandleTypeDef* hltdc) {
    static uint16_t buffer_index = 0;

    buffer_index = 1 - buffer_index;
    uint32_t buffer_addr = (buffer_index) ? LCD_LAYER_1_ADDRESS : LCD_LAYER_0_ADDRESS;
    BSP_LCD_Reload(0, BSP_LCD_RELOAD_NONE); //Disable reloading
    BSP_LCD_SetLayerAddress(0, 0, buffer_addr); //Update the buffer
    UTIL_LCD_Clear(UTIL_LCD_COLOR_BLACK); //Clear the new buffer
}

/* USER CODE END 4 */

void StartLcdTask(void* argument) {
    /* USER CODE BEGIN 5 */
    /* Infinite loop */
    action_t action;
    for (;;) {
        while (osMessageQueueGet(actionQueue, &action, 0U, 0U) == osOK) {
            perform_action(action);
        }
        update_state();
        clear_lines();
        render();
        BSP_LCD_Reload(0, BSP_LCD_RELOAD_VERTICAL_BLANKING);
        osDelay(20);
    }
    /* USER CODE END 5 */
}

void StartInputTask(void* argument) {
    TS_State_t touch_state;
    /* USER CODE BEGIN StartInputTask */
    /* Infinite loop */
    for (;;) {
        BSP_TS_GetState(0, &touch_state);
        //Shift button state
        for (size_t i = 0; i < N_BTN; ++i) {
            buttons[i].state <<= 1;
        }
        //Get new button states
        if (touch_state.TouchDetected) {
            for (size_t i = 0; i < N_BTN; ++i) {
                buttons[i].state |= (buttons[i].x <= touch_state.TouchX &&
                    buttons[i].x + X_BTN >= touch_state.TouchX &&
                    buttons[i].y <= touch_state.TouchY &&
                    buttons[i].y + Y_BTN >= touch_state.TouchY);
            }
        }
        //Update actions
        for (size_t i = 0; i < N_BTN; ++i) {
            if ((buttons[i].state & 0b1111) == 0b0011) {
                buttons[i].polygon.selected = 1 - buttons[i].polygon.selected;
                osMessageQueuePut(actionQueue, &buttons[i].action, 2U, 0U);
            }
        }
        osDelay(10);
    }
    /* USER CODE END StartInputTask */
}

void Error_Handler(void) {
    __disable_irq();
    while (1) {
    }
}
